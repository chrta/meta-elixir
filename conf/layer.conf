## conf/layer.conf
```bitbake
BBPATH .= ":${LAYERDIR}"

# We have a recipes directory, add to BBFILES
BBFILES += "${LAYERDIR}/recipes-*/*/*.bb ${LAYERDIR}/recipes-*/*/*.bbappend"

BBFILE_COLLECTIONS += "elixir-layer"
BBFILE_PATTERN_elixir-layer := "^${LAYERDIR}/"
BBFILE_PRIORITY_elixir-layer = "8"
```
